## embedded_linux/meta_bldc/conf/layer.conf
```bitbake
BBPATH .= ":${LAYERDIR}"

BBFILES += "${LAYERDIR}/recipes-*/*/*.bb \
            ${LAYERDIR}/recipes-*/*/*.bbappend"

BBFILE_COLLECTIONS += "bldc"
BBFILE_PATTERN_bldc = "^${LAYERDIR}/"
BBFILE_PRIORITY_bldc = "6"

LAYERDEPENDS_bldc = "core"
LAYERVERSION_bldc = "1"
LAYERSERIES_COMPAT_bldc = "kirkstone"
```
